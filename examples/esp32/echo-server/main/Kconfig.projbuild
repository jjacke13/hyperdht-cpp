## examples/esp32/echo-server/main/Kconfig.projbuild
```kconfig
menu "HyperDHT Echo Server"

    config WIFI_SSID
        string "WiFi SSID"
        default "myssid"

    config WIFI_PASSWORD
        string "WiFi Password"
        default "mypassword"

    config SERVER_SEED
        string "Server seed (64 hex chars, empty = random)"
        default ""
        help
            Deterministic keypair seed. Leave empty for random
            (public key printed on boot).

endmenu
```

## examples/esp32/main/Kconfig.projbuild
```kconfig
menu "HyperDHT Echo Client"

    config WIFI_SSID
        string "WiFi SSID"
        default "myssid"

    config WIFI_PASSWORD
        string "WiFi Password"
        default "mypassword"

endmenu
```

## examples/esp32/sdkconfig.defaults
```kconfig
# ESP32-S3 target
CONFIG_IDF_TARGET="esp32s3"

# Flash — your board has 16MB, default is 2MB
CONFIG_ESPTOOLPY_FLASHSIZE_16MB=y

# Partition table — 16MB flash gives room for larger app partition
CONFIG_PARTITION_TABLE_CUSTOM=y
CONFIG_PARTITION_TABLE_CUSTOM_FILENAME="partitions.csv"

# lwIP tuning for HyperDHT
CONFIG_LWIP_SO_REUSE=y
CONFIG_LWIP_MAX_SOCKETS=16

# PSRAM (ESP32-S3 with octal PSRAM)
CONFIG_SPIRAM=y
CONFIG_SPIRAM_MODE_OCT=y
CONFIG_SPIRAM_SPEED_80M=y
CONFIG_SPIRAM_USE_MALLOC=y
CONFIG_SPIRAM_MALLOC_ALWAYSINTERNAL=4096
CONFIG_SPIRAM_MALLOC_RESERVE_INTERNAL=65536
CONFIG_SPIRAM_ALLOW_STACK_EXTERNAL_MEMORY=y

# Run on single core — avoids SMP scheduler issues with C++ static init
CONFIG_FREERTOS_UNICORE=y

# Stack sizes — generous for C++ library + crypto + WiFi overhead.
# We have 8MB PSRAM — no reason to be stingy.
CONFIG_ESP_MAIN_TASK_STACK_SIZE=32768
CONFIG_ESP_IPC_TASK_STACK_SIZE=4096
CONFIG_FREERTOS_IDLE_TASK_STACKSIZE=4096
CONFIG_FREERTOS_TIMER_TASK_STACK_DEPTH=8192
CONFIG_ESP_SYSTEM_EVENT_TASK_STACK_SIZE=8192
CONFIG_ESP_WIFI_DYNAMIC_TX_BUFFER_NUM=32
CONFIG_LWIP_TCPIP_TASK_STACK_SIZE=8192
```
